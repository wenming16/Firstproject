#include "SPI.h"

/*=======================================================================
 *函数名:      SPI1_Init(void) 
 *功能:        SPI1初始化
 *参数:        无       
 *返回：       无
 *说明：       通信波特率:1Mhz
               SPI初始化首先需要片选
========================================================================*/
uint8 SPI1_Init(void) 
{

   SS2_Dir = 1;  //SPI片选
   
   SPI1CR1=0b01011100;
   SPI1CR2=0x00;
   SPI1BR=0x71; //1MHz波特率
 
   SS2 = 1;
   return 0;
}
                           
/*=======================================================================
 *函数名:      SPI1_Write(uint8) 
 *功能:        SPI1写数据函数
 *参数:        data：要写的8位数据       
 *返回：       无
 *说明：       SPI1写数据函数
========================================================================*/
void SPI1_Write(uint8 data) 
{
  while(!SPI1SR_SPTEF);                // 每次只能发送一个字节的数据；
  SPI1DRL = data;
}

/*=======================================================================
 *函数名:      SPI1_read(void) 
 *功能:        SPI1读数据函数
 *参数:        无       
 *返回：       无
 *说明：       SPI1读数据函数
========================================================================*/
uint8 SPI1_read(void) 
{
  uint8 temp2,returndata;
 
  while(!SPI1SR_SPIF) 
  temp2 = SPI1SR;   
  
  returndata = SPI1DRL;           //读取数据
  return(returndata); 
}


/*=======================================================================
 *函数名:      wakeup_idle(void) 
               wakeup_sleep(void)
 *功能:        SPI1控制的器件唤醒与SPI1控制的器件休眠
 *参数:        无       
 *返回：       无
 *说明：       SPI1控制的器件唤与SPI1控制的器件休眠
========================================================================*/
void wakeup_idle(void)
{
  SS2=0;
  delay_time(5);                             // Guarantees the isoSPI will be in ready mode
  SS2=1;
} 

void wakeup_sleep(void)
{
  SS2 = 0;
  delay_time(5);                             // Guarantees the LTC6804 will be in standby
  SS2 =1;
}

/*=======================================================================
 *函数名:      delay_time(uint16) 
 *功能:        延时函数
 *参数:        t：延时的周期数       
 *返回：       无
 *说明：       此函数用在唤醒休眠中、写数据和读数据的等待时间中
========================================================================*/
void delay_time(uint16 t)
{
  uint16 i;
  for(i=0; i<t; i++);
}

    
 
